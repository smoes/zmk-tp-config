## boards/shields/skeletyl-tp/Kconfig.defconfig
```kconfig
if SHIELD_SKELETYL_TP_RIGHT

config ZMK_KEYBOARD_NAME
    default "Skeletyl TP"

config ZMK_SPLIT_BLE_ROLE_CENTRAL
    default y

endif

if SHIELD_SKELETYL_TP_LEFT || SHIELD_SKELETYL_TP_RIGHT

config ZMK_SPLIT
    default y

endif
```

## boards/shields/skeletyl-tp/Kconfig.shield
```kconfig
config SHIELD_SKELETYL_TP_LEFT
    def_bool $(shields_list_contains,skeletyl_tp_left)

config SHIELD_SKELETYL_TP_RIGHT
    def_bool $(shields_list_contains,skeletyl_tp_right)
```

## config/west.yml
```yaml
manifest:
  remotes:
    - name: zmkfirmware
      url-base: https://github.com/zmkfirmware
    - name: infused-kim
      url-base: https://github.com/infused-kim 
    - name: smoes
      url-base: https://github.com/smoes 
  projects:
    - name: zmk
      remote: infused-kim
      revision: pr-testing/mouse_ps2_module_base
      import: app/west.yml
    - name: kb_zmk_ps2_mouse_trackpoint_driver
      remote: smoes
      revision: main
  self:
    path: config
```
